## drivers/net/wireless/rockchip_wlan/rtl8723du/Kconfig
```kconfig
# SPDX-License-Identifier: GPL-2.0
config RTL8723DU
        tristate "Realtek 8723D USB WiFi"
        depends on USB
        help
          Help message of RTL8723DU
```
